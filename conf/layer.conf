## conf/layer.conf
```bitbake
LAYERSERIES_COMPAT_meta-servx = "scarthgap"
LAYERSERIES_COMPAT = "scarthgap"

require conf/layer.conf
```

## meta-distrox/conf/distro/distrox.conf
```bitbake
DISTRO = "distrox"
DISTRO_NAME = "DistroX Academic Research Linux Distribution"
DISTRO_VERSION = "0.1.0"
DISTRO_CODENAME = "milkyway"
SDK_VENDOR = "-distroxsdk"
SDK_VERSION = "${@d.getVar('DISTRO_VERSION').replace('snapshot-${METADATA_REVISION}', 'snapshot')}"
SDK_VERSION[vardepvalue] = "${SDK_VERSION}"

MAINTAINER = "Vito Tomas"

TARGET_VENDOR = "-distrox"

LOCALCONF_VERSION = "2"

# Override these in poky based distros
DISTROX_DEFAULT_DISTRO_FEATURES = "opengl multiarch wayland vulkan"
DISTROX_DEFAULT_EXTRA_RDEPENDS = "packagegroup-core-boot"
DISTROX_DEFAULT_EXTRA_RRECOMMENDS = "kernel-module-af-packet"

DISTRO_FEATURES ?= "${DISTRO_FEATURES_DEFAULT} ${DISTROX_DEFAULT_DISTRO_FEATURES}"

PREFERRED_VERSION_linux-yocto ?= "6.6%"
PREFERRED_VERSION_linux-yocto-rt ?= "6.6%"

SDK_NAME = "${DISTRO}-${TCLIBC}-${SDKMACHINE}-${IMAGE_BASENAME}-${TUNE_PKGARCH}-${MACHINE}"
SDKPATHINSTALL = "/opt/${DISTRO}/${SDK_VERSION}"

DISTRO_EXTRA_RDEPENDS += "${DISTROX_DEFAULT_EXTRA_RDEPENDS}"
DISTRO_EXTRA_RRECOMMENDS += "${DISTROX_DEFAULT_EXTRA_RRECOMMENDS}"

TCLIBCAPPEND = ""

PACKAGE_CLASSES ?= "package_rpm"

# QA check settings - a little stricter than the OE-Core defaults
# (none currently necessary as we now match OE-Core)
#WARN_TO_ERROR_QA = "X"
#WARN_QA_remove = "${WARN_TO_ERROR_QA}"
#ERROR_QA_append = " ${WARN_TO_ERROR_QA}"

require conf/distro/include/poky-world-exclude.inc
require conf/distro/include/no-static-libs.inc
require conf/distro/include/yocto-uninative.inc
require conf/distro/include/security_flags.inc
INHERIT += "uninative"

BB_SIGNATURE_HANDLER ?= "OEEquivHash"
BB_HASHSERVE ??= "auto"

DISTROX_INIT_MANAGER = "sysvinit"
INIT_MANAGER ?= "${DISTROX_INIT_MANAGER}"

# We need debug symbols so that SPDX license manifests for the kernel work
KERNEL_EXTRA_FEATURES:append = " features/debug/debug-kernel.scc"

# Enable creation of SPDX manifests by default
INHERIT += "create-spdx"
```
